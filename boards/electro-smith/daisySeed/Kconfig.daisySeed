## boards/electro-smith/daisySeed/Kconfig.daisySeed
```kconfig
# Copyright (c) 2023 STMicroelectronics
# SPDX-License-Identifier: Apache-2.0

config BOARD_DAISY_SEED
	select SOC_STM32H750XX
```

## boards/electro-smith/daisySeed/board.yml
```yaml
# Copyright (c) 2024 Nordic Semiconductor ASA
# SPDX-License-Identifier: Apache-2.0

board:
  name: daisy_seed
  vendor: electro-smith
  socs:
    - name: stm32h750xx
```
